## arch/arm64/Kconfig.htc
```kconfig
comment "HTC Debugging Features"
menuconfig HTC_DEBUG
	bool "HTC Debugging Feature Switch"
	default y
	help
	  Enable collection of debug features.
	  This feature is enabled in defconfig.

config HTC_DEBUG_WORKQUEUE
	bool "HTC style workqueue debug features"
	depends on HTC_DEBUG
	help
	  Say Y here if you want the HTC style workqueue debug features

config HTC_DEBUG_WATCHDOG
	bool "HTC style watchdog debug features"
	depends on HTC_DEBUG && MSM_WATCHDOG_V2
	help
	  Say Y here if you want the HTC style watchdog debug features

config HTC_DEBUG_RTB
	default y
	depends on HTC_DEBUG && MSM_RTB
	bool "HTC style rtb debug features"
	help
	  Say Y here if you want the HTC style rtb debug features

config HTC_DEBUG_SSR
	bool "HTC style subsys restart debug features"
	depends on HTC_DEBUG && MSM_SUBSYSTEM_RESTART
	help
	  Say Y here if you want the HTC style subsys restart debug features

config HTC_DEBUG_DSP
        bool "HTC debug feature for trigger ramdump when lpass related timeout"
        depends on HTC_DEBUG
        default n
        help
          This option enables the trigger ramdump when lpass command timeout.

comment "HTC features"
menuconfig HTC_FEATURES
	bool "HTC Implement Features"
	default n
	help
	  Enable collection of HTC features.
	  This feature is enabled in defconfig.

config HTC_FEATURES_SSR
	bool "HTC style ssr features"
	depends on HTC_FEATURES && MSM_SUBSYSTEM_RESTART
	default n
	help
	  Say Y here if you want the HTC style ssr features

config HTC_FEATURES_SSR_MODEM_ENABLE
	bool "HTC style modem ssr features"
	depends on HTC_FEATURES_SSR
	default n
	help
	  Say Y here if you want the HTC style for modem ssr features

config HTC_FEATURES_SSR_LPASS_ENABLE
       bool "HTC style lpass ssr features"
       depends on HTC_FEATURES_SSR
       default n
       help
         Say Y here if you want the HTC style for lpass ssr features
```

## drivers/htc_debug/stability/Kconfig
```kconfig
#
# HTC_DEBUG stability Kconfig
#

config HTC_DEBUG_RAMOOPS
	bool "Log panic/oops to a RAM buffer"
	default n
	depends on PSTORE_CONSOLE
	help
	  This enables panic and oops messages to be logged to a circular
	  buffer in RAM where it can be read back at some later point.

config HTC_DEBUG_BOOTLOADER_LOG
	bool "HTC style ram console debug features"
	default n
	depends on PSTORE_CONSOLE && HTC_DEBUG_RAMOOPS
	help
	  Say Y here if you want the HTC style ram console debug features

config HTC_HELPER_FUNCTIONS
	bool "HTC helper functions"
	default n
	help
	  Extract debug flag from kernel cmdline and define read-only
	  functions to global kernel space

config HTC_DEBUG_WORKQUEUE
	default y
	depends on HTC_DEBUG
	bool "HTC style workqueue debug features"
	help
	  Say Y here if you want the HTC style workqueue debug features

config HTC_NC_GPIO_PIN_SETTING
	bool "HTC style nc pin setting features"
	default n
	help
	  Say Y here if you want the HTC style nc pin setting features

config HTC_PROCESS_DEBUG
	bool "process/thread debug support"
	default y
	help
	  This option enables kernel debug log to check if any
	  assigned process receives signal or unexpected exit

config HTC_DEBUG_KP
	default y
	depends on HTC_DEBUG
	bool "HTC style kernel panic debug features"
	help
	  Say Y here if you want the HTC style kernel panic debug features

config HTC_DEBUG_VMALLOC_DUMP
	default y
	bool "HTC style vmalloc fail debug features"
	depends on HTC_DEBUG
	help
	  This option enables the dump for vmalloc info when vmalloc failed.
	  The same information could also be get under /proc/vmallocinfo

config HTC_DEBUG_SAVE_BOOT_MSG
	default y
	depends on HTC_DEBUG
	bool "HTC debug: saving kernel log of booting to memory"

config SLUB_LIGHT_WEIGHT_DEBUG_ON
	bool "SLUB light weight debugging on by default"
	depends on SLUB && SLUB_DEBUG && SLUB_DEBUG_ON && !KMEMCHECK
	default n
	help
	  Light weight memory corruption debugging for slub. Only SLAB_STORE_USER
	  and SLAB_DEBUG_FREE was choosen.

config HTC_DEBUG_DYING_PROCS
	default y
	bool "HTC debug feature for recording dying processes"
	help
	  This option enables the recording of latest 10 killed processes in
	  /proc/dying_processes

config HTC_WFE_DISABLE
       default n
       bool "Disable WFE instruction to avoid CPU issue"
       help
         Disable ARM wfe instruction which might cause CPU hang and trigger
         watchdog reset.

config HTC_EARLY_RTB
       bool "HTC debug feature for enabling RTB before driver is initial"
       default y
       depends on MSM_RTB && HTC_DEBUG && OF && OF_ADDRESS
       help
         This option enables the RTB mechanism before RTB driver is brought up.
         The RTB Log buffer start-address and buffer-size is defined by device-tree.

config HTC_DEBUG_RESTART_TIMER
       bool "add a timer in restart flow"
       default y
       depends on HTC_DEBUG

config HTC_DEBUG_PAGE_USER_TRACE
	bool "Record call trace of page user in page structure"
	depends on PAGE_POISONING
	default n
	help
	  For debugging purpose, add call trace of user (freer and
	  allocator) to page structure

config HTC_DEBUG_PAGE_ENTRIES_NR
	int
	default 4
```

## drivers/htc_power_debug/Kconfig
```kconfig
config HTC_POWER_DEBUG_RAILWAYS
    bool "HTC power Debug RAILWAYS support"
    depends on HTC_POWER_DEBUG
    default n
    help
      Say yes to enable HTC debug RAILWAYS for power rails related debug function.
```

## drivers/htc_ril/Kconfig
```kconfig
config HTC_RADIO_SMEM
	bool "RADIO SMEM"
	default N
	---help---
	Enable to move necessary non-secure data to shared memory

config HTC_MODEM_NOTIFIER
	bool "MODEM NOTIFIER"
	default N
	---help---
	Enable to notify modem APP is rebooting

config HTC_DEBUG_RIL_PCN0002_DUMP_STACK
	tristate "HTC_DEBUG_RIL_PCN0002_DUMP_STACK"
	default Y
	help
         Say Y here if you want dump call stack when modem crash

config HTC_DEBUG_RIL_PCN0009_SSR_DUMP_TASK
	tristate "HTC_DEBUG_RIL_PCN0009_SSR_DUMP_TASK"
	default Y
	---help---
	Dump busy task and disk sleep task if modem ssr over 5 seconds. If device enable radio flag 8 8, It will trigger panic if SSR timeout over 20 seconds.
```

## drivers/misc/fpr_CrucialTec/Kconfig
```kconfig
#
# TI's shared transport line discipline and the protocol
# drivers (BT, FM and GPS)
#
menu "CrucialTec fingerprint SPI driver"
config FPR_CT
       default n
       tristate "FPC_BTP fingerprint sensor support"
       depends on SPI_MASTER
endmenu
```

## drivers/misc/fpr_FingerprintCard_REE/Kconfig
```kconfig
#
# TI's shared transport line discipline and the protocol
# drivers (BT, FM and GPS)
#
menu "FingerprintCard fingerprint REE SPI driver"
config FPR_FPC_REE
       default n
       tristate "FPC_REE fingerprint sensor support"
       depends on SPI_MASTER
endmenu
```

## drivers/misc/fpr_Synaptics/Kconfig
```kconfig
#
# TI's shared transport line discipline and the protocol
# drivers (BT, FM and GPS)
#
menu "Synaptics fingerprint SPI driver"
config FPR_SYN
	bool "SPI driver for fingerprint"
    default n
	help
         SPI driver for finger print
endmenu
```

## drivers/usb/fusb302/Kconfig
```kconfig
config FUSB_30X
	bool "Fairchild Type-C interface support"
	default y
	---help---
	  Fairchild type-c interface is a chip support USB PD protocol device
```
