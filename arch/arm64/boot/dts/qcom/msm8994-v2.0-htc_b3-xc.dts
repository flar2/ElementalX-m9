/dts-v1/;

#include "msm8994-v2.0.dtsi"
#include "msm8994-htc_b3.dtsi"
#include "msm8994-htc_b3-pm-pmi-gpio.dtsi"
//HTC_CAM_START, use new dtsi after xc board
#include "msm8994-camera-sensor-b3-xc.dtsi"
//HTC_CAM_END

/ {
	model = "HTC Corporation. MSM8994v2.0 B3 XC";
	qcom,msm-id = <384 0x20000>, <385 0x20000>;
	qcom,board-id = <2 0>;
};
