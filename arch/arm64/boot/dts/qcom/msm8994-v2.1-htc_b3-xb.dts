/dts-v1/;

#include "msm8994-v2.1.dtsi"
#include "msm8994-htc_b3.dtsi"
#include "msm8994-htc_b3-pm-pmi-gpio.dtsi"

/ {
	model = "HTC Corporation. MSM8994v2.1 B3 XB";
	qcom,msm-id = <384 0x20001>, <385 0x20001>;
	qcom,board-id = <1 0>;
};
