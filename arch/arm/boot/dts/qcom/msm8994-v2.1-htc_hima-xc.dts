/dts-v1/;

#include "msm8994-v2.1.dtsi"
#include "msm8994-htc_hima.dtsi"
#include "msm8994-htc_hima-pm-pmi-gpio.dtsi"

/ {
	model = "HTC Corporation. MSM8994v2.1 HIMA XC";
	qcom,msm-id = <368 0x20001>, <363 0x20001>, <372 0x20001>,
	              <361 0x20001>, <367 0x20001>, <362 0x20001>,
	              <355 0x20001>;
	qcom,board-id = <2 0>;
};
