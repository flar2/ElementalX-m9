qcom,acadia-id2-batterydata {
	qcom,max-voltage-uv = <4400000>;
	qcom,v-cutoff-uv = <3400000>;
	qcom,chg-term-ua = <100000>;
	qcom,nom-batt-capacity-mah = <3200>;
	qcom,batt-id-kohm = <33>;
	qcom,battery-beta = <4360>;
	qcom,battery-type = "acadia_id2";
	qcom,chg-rslow-comp-c1 = <4003269>;
	qcom,chg-rslow-comp-c2 = <7220195>;
	qcom,chg-rs-to-rslow = <883973>;
	qcom,chg-rslow-comp-thr = <0xB8>;
	qcom,checksum = <0x3F12>;
	qcom,gui-version = "PMI8994GUI - 2.1.6.9";
	htc,batt_id = <2>;
	htc,id_raw_min = <22001>;
	htc,id_raw_max = <40000>;
	qcom,fg-profile-data = [
		 D8 83 71 7C
		 D0 80 B3 76
		 68 83 59 75
		 06 8A E8 94
		 FF 81 D4 9A
		 AA BD 45 CA
		 55 11 EE 83
		 C7 7C F1 80
		 CC 76 5F 83
		 A0 54 2E 83
		 22 8F 49 82
		 D5 99 20 BD
		 14 CA 53 0E
		 D8 0C AB 5A
		 14 70 B8 FE
		 5E 3D 16 3F
		 07 39 00 00
		 FC 45 B8 3A
		 A5 3F 00 00
		 00 00 00 00
		 00 00 00 00
		 7C 6B 24 6A
		 69 60 CC 8A
		 51 7C D1 70
		 88 74 08 80
		 D7 76 CA 6A
		 9F 76 85 A8
		 1D CB 59 16
		 5C A0 71 0C
		 28 00 FF 36
		 F0 11 30 03
		 00 00 00 0C
	];
};
