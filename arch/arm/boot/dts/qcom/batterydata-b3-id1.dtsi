/* Copyright (c) 2013-2014, The Linux Foundation. All rights reserved.
 *
 * This program is free software; you can redistribute it and/or modify
 * it under the terms of the GNU General Public License version 2 and
 * only version 2 as published by the Free Software Foundation.
 *
 * This program is distributed in the hope that it will be useful,
 * but WITHOUT ANY WARRANTY; without even the implied warranty of
 * MERCHANTABILITY or FITNESS FOR A PARTICULAR PURPOSE.  See the
 * GNU General Public License for more details.
 */

qcom,b3-id1-batterydata {
	qcom,max-voltage-uv = <4400000>;
	qcom,v-cutoff-uv = <3400000>;
	qcom,chg-term-ua = <100000>;
	qcom,nom-batt-capacity-mah = <2700>;
	qcom,batt-id-kohm = <10>;
	qcom,battery-beta = <4360>;
	qcom,battery-type = "b3_id1";
	qcom,checksum = <0x2114>;
	htc,batt_id = <1>;
	htc,id_raw_min = <1000>;
	htc,id_raw_max = <200000>;

	qcom,fg-profile-data = [
		 95 82 6A 78 
		 DA 5E DA 5A 
		 28 83 BD 78 
		 2C 85 5D 81 
		 D2 81 55 9B 
		 9B BE 67 D0 
		 A7 0E 0D 83 
		 CF 6A B2 70 
		 57 64 3D 83 
		 25 78 F5 7F 
		 1C 7B 1E 82 
		 1E 9A FE BC 
		 9C C9 7D 0C 
		 2F 0B 1D 5A 
		 14 70 B8 FE 
		 AA 47 AB 44 
		 48 4A 00 00 
		 F9 46 19 38 
		 40 29 00 00 
		 00 00 00 00 
		 00 00 00 00 
		 A8 70 9E 70 
		 2A 54 55 88 
		 7C 74 01 60 
		 4C 48 4B 80 
		 09 6F C2 30 
		 C7 69 26 B2 
		 1F FE 60 66 
		 5E A0 71 0C 
		 28 00 FF 36 
		 F0 11 30 03 
		 00 00 00 00 
	];
};
