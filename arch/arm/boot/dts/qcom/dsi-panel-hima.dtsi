/* Copyright (c) 2013-2014, The Linux Foundation. All rights reserved.
 *
 * This program is free software; you can redistribute it and/or modify
 * it under the terms of the GNU General Public License version 2 and
 * only version 2 as published by the Free Software Foundation.
 *
 * This program is distributed in the hope that it will be useful,
 * but WITHOUT ANY WARRANTY; without even the implied warranty of
 * MERCHANTABILITY or FITNESS FOR A PARTICULAR PURPOSE.  See the
 * GNU General Public License for more details.
 */

/*---------------------------------------------------------------------------
 * This file is autogenerated file using gcdb parser. Please do not edit it.
 * Update input XML file to add a new entry or update variable in this file
 * VERSION = "1.0"
 *---------------------------------------------------------------------------*/
&mdss_mdp {
	qcom,mdss_dsi_hima_jdi_1080p_cmd {
		compatible = "qcom,mdss_dsi_hima_jdi_1080p_cmd";
		qcom,mdss-dsi-panel-name = "HIMA FHD JDI/Renesas cmd mode dsi panel";
		qcom,mdss-dsi-panel-controller = <&mdss_dsi0>;
		qcom,mdss-dsi-panel-type = "dsi_cmd_mode";
		qcom,mdss-dsi-panel-destination = "display_1";
		qcom,mdss-dsi-panel-framerate = <60>;
		qcom,mdss-dsi-virtual-channel-id = <0>;
		qcom,mdss-dsi-stream = <0>;
		qcom,mdss-dsi-panel-width = <1080>;
		qcom,mdss-dsi-panel-height = <1920>;
		qcom,mdss-dsi-h-front-porch = <38>;
		qcom,mdss-dsi-h-back-porch = <27>;
		qcom,mdss-dsi-h-pulse-width = <10>;
		qcom,mdss-dsi-h-sync-skew = <0>;
		qcom,mdss-dsi-v-back-porch = <4>;
		qcom,mdss-dsi-v-front-porch = <4>;
		qcom,mdss-dsi-v-pulse-width = <2>;
		qcom,mdss-dsi-h-left-border = <0>;
		qcom,mdss-dsi-h-right-border = <0>;
		qcom,mdss-dsi-v-top-border = <0>;
		qcom,mdss-dsi-v-bottom-border = <0>;
		qcom,mdss-dsi-bpp = <24>;
		qcom,mdss-dsi-color-order = "rgb_swap_rgb";
		qcom,mdss-dsi-underflow-color = <0xff>;
		qcom,mdss-dsi-border-color = <0>;
		qcom,mdss-dsi-on-command = [
			29 01 00 00 00 00 02 b0 04
			/* unlock_command cmd=0xB0 */
			29 01 00 00 00 00 18 ce 6c 40 43 49 55 62 71 82 94 a8 b9 cb db e9 f5 fc ff 01 5a 00 00 54 20
			/* common_setting cmd=0xCE */
			29 01 00 00 00 00 07 b9 03 82 3c 10 3c 87
			/* cabc_still cmd=0xB9 */
			29 01 00 00 00 00 07 ba 03 78 64 10 64 b4
			/* cabc_movie cmd=0xBA */
			29 01 00 00 00 00 04 bb 01 00 00
			/* SRE_Manual_0 cmd=0xBB */
			29 01 00 00 00 00 22 ca 01 02 9a a4 b8 b4 b0 a4 08 28 05 87 b0 50 01 ff 05 f8 0c 0c 50 40 13 13 f0 08 10 10 3f 3f 3f 3f ff
			/* jdi_Color_enhancement cmd=0xCA */
			29 01 00 00 00 00 02 d6 01
			/* Manufacture_Command_setting cmd=0xD6 */
			29 01 00 00 00 00 02 b0 03
			/* lock_command cmd=0xB0 value=0x03 */
			05 01 00 00 78 00 01 11
			/* exit_sleep_mode wait 120 ms cmd=0x11 */
			05 01 00 00 00 00 01 53
			/* write_control_display cmd=0x53 */
			05 01 00 00 00 00 02 55 42
			/* Write_Content_Adaptive_Brightness_Control cmd=0x55 */
			05 01 00 00 00 00 01 5e
			/* cabc_bl_limit cmd=0x5E */
			05 01 00 00 00 00 01 35
			/* enable_te cmd=0x35 */
			05 01 00 00 14 00 02 29 00
			/* display_on wait 20 ms cmd=0x29 DTYPE_DCS_LWRITE(0x39)*/
		];
		qcom,mdss-dsi-off-command = [
			05 01 00 00 00 00 01 28
			/* display_off cmd=0x28 */
			05 01 00 00 30 00 01 10
			/* enter_sleep_mode wait 48 ms cmd=0x10 */
			29 01 00 00 00 00 02 b0 04
			/* lock_command cmd=0xB0 cmd=0xB0 */
			29 01 00 00 00 00 02 b1 01
			/* deep_standby_off cmd=0xB1 */
		];
		qcom,mdss-dsi-on-command-state = "dsi_lp_mode";
		qcom,mdss-dsi-off-command-state = "dsi_hs_mode";
		qcom,mdss-dsi-h-sync-pulse = <0>;
		qcom,mdss-dsi-traffic-mode = "non_burst_sync_event";
		qcom,mdss-dsi-lane-map = "lane_map_0123";
		qcom,mdss-dsi-bllp-eof-power-mode;
		qcom,mdss-dsi-bllp-power-mode;
		qcom,mdss-dsi-panel-broadcast-mode;
		qcom,mdss-dsi-lane-0-state;
		qcom,mdss-dsi-lane-1-state;
		qcom,mdss-dsi-lane-2-state;
		qcom,mdss-dsi-lane-3-state;
		qcom,mdss-dsi-panel-timings = [2d 32 22 00 60 64 26 36 29 03 04 00];
		qcom,mdss-dsi-t-clk-post = <0x03>;
		qcom,mdss-dsi-t-clk-pre = <0x21>;
		qcom,mdss-dsi-bl-min-level = <1>;
		qcom,mdss-dsi-bl-max-level = <4095>;
		qcom,mdss-dsi-dma-trigger = "trigger_sw";
		qcom,mdss-dsi-mdp-trigger = "none";
		qcom,mdss-dsi-bl-pmic-control-type = "bl_ctrl_wled";
		qcom,mdss-dsi-reset-sequence = <1 100>, <0 100>, <1 100>;
		qcom,mdss-dsi-te-pin-select = <1>;
		qcom,mdss-dsi-wr-mem-start = <0x2c>;
		qcom,mdss-dsi-wr-mem-continue = <0x3c>;
		qcom,mdss-dsi-te-dcs-command = <1>;
		qcom,mdss-dsi-te-check-enable;
		qcom,mdss-dsi-te-using-te-pin;
		htc,mdss-camera-blk = <148>;
		htc,mdss-camera-dua-blk = <148>;
		htc,panel-id = <0>;
		htc,mdss-skip-first-pinctl = <1>;
		qcom,cont-splash-enabled;
	};

	qcom,mdss_dsi_hima_tianma_renesas_1080p_video {
		compatible = "qcom,mdss_dsi_hima_tianma_renesas_1080p_video";
		qcom,mdss-dsi-panel-name = "HIMA FHD Tianma/Renesas video mode dsi panel";
		qcom,mdss-dsi-panel-controller = <&mdss_dsi0>;
		qcom,mdss-dsi-panel-type = "dsi_video_mode";
		qcom,mdss-dsi-panel-destination = "display_1";
		qcom,mdss-dsi-panel-framerate = <60>;
		qcom,mdss-dsi-virtual-channel-id = <0>;
		qcom,mdss-dsi-stream = <0>;
		qcom,mdss-dsi-panel-width = <1080>;
		qcom,mdss-dsi-panel-height = <1920>;
		qcom,mdss-dsi-h-front-porch = <123>;
		qcom,mdss-dsi-h-back-porch = <68>;
		qcom,mdss-dsi-h-pulse-width = <20>;
		qcom,mdss-dsi-h-sync-skew = <0>;
		qcom,mdss-dsi-v-back-porch = <4>;
		qcom,mdss-dsi-v-front-porch = <3>;
		qcom,mdss-dsi-v-pulse-width = <2>;
		qcom,mdss-dsi-h-left-border = <0>;
		qcom,mdss-dsi-h-right-border = <0>;
		qcom,mdss-dsi-v-top-border = <0>;
		qcom,mdss-dsi-v-bottom-border = <0>;
		qcom,mdss-pan-physical-width-dimension  = <62>;
		qcom,mdss-pan-physical-height-dimension = <110>;
		qcom,mdss-dsi-bpp = <24>;
		qcom,mdss-dsi-color-order = "rgb_swap_rgb";
		qcom,mdss-dsi-underflow-color = <0xff>;
		qcom,mdss-dsi-border-color = <0>;
		qcom,mdss-dsi-on-command = [
			29 00 00 00 00 00 02 B0 04
			39 00 00 00 00 00 02 3A 70				/*set pixel format*/
			15 00 00 00 00 00 02 51 FF
			15 00 00 00 00 00 02 53 2C
			15 00 00 00 00 00 02 55 02
			15 00 00 00 00 00 02 35 00
			29 00 00 00 00 00 1A D3 1B 33 BB BB B3 33 33 33 00	/*Power setting*/
					     01 00 A0 E8 A0 0D 46 46 33 3B
					     37 72 57 3D BF 33
			29 00 00 00 00 00 21 CA 01 01 97 75 97 A8 BB A8 08	/*CE Setting*/
					     2F 05 78 0A 4A 37 A0 01 A0 08
					     08 20 10 08 08 CB F2 10 10 3F
					     3F 3F 3F
			29 00 00 00 00 00 07 B9 07 7A 45 20 13 4B	/*CABC still mode*/
			29 00 00 00 00 00 07 BA 07 7C 57 20 13 99	/*CABC movie mode*/
			29 00 00 00 00 00 18 CE 75 00 01 02 03 45 C5 DC E3	/*PWM freq=40kHz*/
					     ED F4 F7 F9 FB FD FE FF 01 5F
					     04 04 44 20
			05 00 00 00 0A 00 01 29	/* Delay = 10ms*/
			05 01 00 00 80 00 01 11	/* Delay >120ms*/
		];
		qcom,mdss-dsi-off-command = [
			05 00 00 00 00 00 01 28					/*Display Off*/
			29 00 00 00 33 00 1A D3 13 33 BB B3 B3 33 33 33 00	/*Power Setting,Delay >50ms*/
					     01 00 A0 E8 A0 0D 46 46 33 3B
					     37 72 57 3D BF 33
			05 01 00 00 51 00 01 10					/*Sleep in,Delay >80ms*/
		];
		qcom,mdss-dsi-on-command-state = "dsi_lp_mode";
		qcom,mdss-dsi-off-command-state = "dsi_hs_mode";
		qcom,mdss-dsi-h-sync-pulse = <0>;
		qcom,mdss-dsi-traffic-mode = "non_burst_sync_event";
		qcom,mdss-dsi-lane-map = "lane_map_0123";
		qcom,mdss-dsi-bllp-eof-power-mode;
		qcom,mdss-dsi-bllp-power-mode;
		qcom,mdss-dsi-panel-broadcast-mode;
		qcom,mdss-dsi-lane-0-state;
		qcom,mdss-dsi-lane-1-state;
		qcom,mdss-dsi-lane-2-state;
		qcom,mdss-dsi-lane-3-state;
		qcom,mdss-dsi-panel-timings = [E6 38 26 00 68 6C 2A 3C 2C 03 04 00];
		qcom,mdss-dsi-t-clk-post = <0x02>;
		qcom,mdss-dsi-t-clk-pre = <0x2B>;
		qcom,mdss-dsi-bl-min-level = <1>;
		qcom,mdss-dsi-bl-max-level = <4095>;
		qcom,mdss-dsi-dma-trigger = "trigger_sw";
		qcom,mdss-dsi-mdp-trigger = "none";
		qcom,mdss-dsi-bl-pmic-control-type = "bl_ctrl_wled";
		qcom,mdss-dsi-reset-sequence = <1 100>, <0 100>, <1 100>;
		qcom,mdss-dsi-te-pin-select = <1>;
		qcom,mdss-dsi-wr-mem-start = <0x2c>;
		qcom,mdss-dsi-wr-mem-continue = <0x3c>;
		qcom,mdss-dsi-te-dcs-command = <1>;
		qcom,mdss-dsi-te-check-enable;
		qcom,mdss-dsi-te-using-te-pin;
		qcom,cont-splash-enabled;
		htc,mdss-max-brt-level = <4095>;
		htc,mdss-camera-blk = <148>;
		htc,mdss-camera-dua-blk = <148>;
		htc,panel-id = <1>;
		htc,mdss-skip-first-pinctl = <1>;
		htc,mdss-bl-brt = <40 50 1420 2550 3580 4095>;
	};

	qcom,mdss_dsi_hima_tdi_res69338_1080p_video {
		compatible = "qcom,mdss_dsi_hima_tdi_res69338_1080p_video";
		qcom,mdss-dsi-panel-name = "HIMA FHD TDI/Renesas video mode dsi panel";
		qcom,mdss-dsi-panel-controller = <&mdss_dsi0>;
		qcom,mdss-dsi-panel-type = "dsi_video_mode";
		qcom,mdss-dsi-panel-destination = "display_1";
		qcom,mdss-dsi-panel-framerate = <60>;
		qcom,mdss-dsi-virtual-channel-id = <0>;
		qcom,mdss-dsi-stream = <0>;
		qcom,mdss-dsi-panel-width = <1080>;
		qcom,mdss-dsi-panel-height = <1920>;
		qcom,mdss-dsi-h-front-porch = <151>;
		qcom,mdss-dsi-h-back-porch  = <40>;
		qcom,mdss-dsi-h-pulse-width = <20>;
		qcom,mdss-dsi-h-sync-skew   = <0>;
		qcom,mdss-dsi-v-front-porch = <4>;
		qcom,mdss-dsi-v-back-porch  = <3>;
		qcom,mdss-dsi-v-pulse-width = <1>;
		qcom,mdss-dsi-h-left-border = <0>;
		qcom,mdss-dsi-h-right-border  = <0>;
		qcom,mdss-dsi-v-top-border    = <0>;
		qcom,mdss-dsi-v-bottom-border = <0>;
		qcom,mdss-pan-physical-width-dimension  = <62>;
		qcom,mdss-pan-physical-height-dimension = <110>;
		qcom,mdss-dsi-bpp = <24>;
		qcom,mdss-dsi-color-order = "rgb_swap_rgb";
		qcom,mdss-dsi-underflow-color = <0xff>;
		qcom,mdss-dsi-border-color = <0>;
		qcom,mdss-dsi-on-command = [
			23 00 00 00 05 00 02 B0 04	/*Manufacturer cmd protect off*/
			15 00 00 00 00 00 02 55 02	/*Cabc, SRE control*/
			29 00 00 00 00 00 07 B9 07 75 40 20 0A 4B	/*cabc_still*/
			29 00 00 00 00 00 07 BA 07 8A 40 20 0A 99	/*cabc_movie*/
			29 00 00 00 00 00 18 CE 75 01 02 03 54 A0 C3 D3 D4	/*cabc*/
					     D5 DF E0 ED EE EF F0 FF 01 5F
					     04 04 44 00
			29 00 00 00 00 00 21 CA 01 01 97 75 97 A8 BB A8 04	/*Color Enhance*/
					     2F 05 70 0A 4A 37 A0 01 A0 08
					     08 20 10 08 08 DD D0 10 10 3F
					     3F 3F 3F
			29 00 00 00 05 00 02 D6 01		/*NVM Load control*/
			29 00 00 00 05 00 02 B0 03		/*Manufacturer cmd protect on*/

			15 00 00 00 00 00 02 51 FF		/*Backlight value*/
			15 00 00 00 00 00 02 53 2C		/*Backlight control*/
			15 00 00 00 00 00 02 35 00		/*TE Enable*/

			05 00 00 00 78 00 01 29			/*Display on*/
			05 01 00 00 00 00 01 11			/*Sleep out*/
		];
		qcom,mdss-dsi-off-command = [
			05 00 00 00 15 00 01 28		/*Display Off*/
			05 01 00 00 3C 00 01 10		/*Sleep in*/
		];
		qcom,mdss-dsi-on-command-state = "dsi_lp_mode";
		qcom,mdss-dsi-off-command-state = "dsi_hs_mode";
		qcom,mdss-dsi-h-sync-pulse = <0>;
		qcom,mdss-dsi-traffic-mode = "non_burst_sync_event";
		qcom,mdss-dsi-lane-map = "lane_map_0123";
		qcom,mdss-dsi-bllp-eof-power-mode;
		qcom,mdss-dsi-bllp-power-mode;
		qcom,mdss-dsi-panel-broadcast-mode;
		qcom,mdss-dsi-lane-0-state;
		qcom,mdss-dsi-lane-1-state;
		qcom,mdss-dsi-lane-2-state;
		qcom,mdss-dsi-lane-3-state;
		qcom,mdss-dsi-panel-timings = [E6 38 26 00 68 6C 2A 3C 2C 03 04 00];
		qcom,mdss-dsi-t-clk-post = <0x02>;
		qcom,mdss-dsi-t-clk-pre  = <0x2B>;
		qcom,mdss-dsi-bl-min-level = <1>;
		qcom,mdss-dsi-bl-max-level = <4095>;
		qcom,mdss-dsi-dma-trigger = "trigger_sw";
		qcom,mdss-dsi-mdp-trigger = "none";
		qcom,mdss-dsi-bl-pmic-control-type = "bl_ctrl_wled";
		qcom,mdss-dsi-reset-sequence = <1 100>, <0 100>, <1 100>;
		qcom,mdss-dsi-te-pin-select = <1>;
		qcom,mdss-dsi-wr-mem-start = <0x2c>;
		qcom,mdss-dsi-wr-mem-continue = <0x3c>;
		qcom,mdss-dsi-te-dcs-command = <1>;
		qcom,mdss-dsi-te-check-enable;
		qcom,mdss-dsi-te-using-te-pin;
		qcom,cont-splash-enabled;
		htc,mdss-max-brt-level = <4095>;
		htc,mdss-camera-blk = <148>;
		htc,mdss-camera-dua-blk = <148>;
		htc,panel-id = <2>;
		htc,mdss-skip-first-pinctl = <1>;
		htc,mdss-bl-brt = <40 50 1420 2550 3580 4095>;
	};
};
