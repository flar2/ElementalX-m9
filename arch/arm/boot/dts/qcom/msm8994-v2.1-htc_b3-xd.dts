/dts-v1/;

#include "msm8994-v2.1.dtsi"
#include "msm8994-htc_b3.dtsi"
#include "msm8994-htc_b3-pm-pmi-gpio.dtsi"
//HTC_CAM_START, use new dtsi after xc board
#include "msm8994-camera-sensor-b3-xc.dtsi"
//HTC_CAM_END

/ {
	model = "HTC Corporation. MSM8994v2.1 B3 XD";
	qcom,msm-id = <384 0x20001>, <385 0x20001>;
	qcom,board-id = <3 0>;
};
